SECTIONS
{
    HIDDEN(__romPos = 0);
    room_m350_cruiser_ROM_START = __romPos;
    room_m350_cruiser_VRAM = ADDR(.room_m350_cruiser);
    .room_m350_cruiser (OVERLAY_WINDOW_ROOM + 0x0) : AT(room_m350_cruiser_ROM_START) SUBALIGN(4)
    {
        FILL(0x00000000);
        room_m350_cruiser_RODATA_START = .;
        build/JP/overlays/room_m350_cruiser/asm/JP/overlays/room_m350_cruiser/data/room_m350.rodata.s.o(.rodata);
        build/JP/overlays/room_m350_cruiser/src-jp/overlays/room_lib/actor_classes.c.o(.rodata);
        build/JP/overlays/room_m350_cruiser/asm/JP/overlays/room_m350_cruiser/data/RoomLib_HandlerCArgsData_801915BC.rodata.s.o(.rodata);
        build/JP/overlays/room_m350_cruiser/src-jp/overlays/room_m350_cruiser/m350.c.o(.rodata);
        build/JP/overlays/room_m350_cruiser/src-jp/overlays/room_m350_cruiser/RoomEffect_ConfiguredPulseCallback.c.o(.rodata);
        build/JP/overlays/room_m350_cruiser/src-jp/overlays/room_m350_cruiser/m350_callbacks.c.o(.rodata);
        . = ALIGN(., 4);
        room_m350_cruiser_RODATA_END = .;
        room_m350_cruiser_RODATA_SIZE = ABSOLUTE(room_m350_cruiser_RODATA_END - room_m350_cruiser_RODATA_START);
        room_m350_cruiser_TEXT_START = .;
        build/JP/overlays/room_m350_cruiser/src-jp/overlays/room_lib/actor_classes.c.o(.text);
        build/JP/overlays/room_m350_cruiser/src-jp/overlays/room_m350_cruiser/m350.c.o(.text);
        build/JP/overlays/room_m350_cruiser/src-jp/overlays/room_m350_cruiser/RoomEffect_ConfiguredPulseCallback.c.o(.text);
        build/JP/overlays/room_m350_cruiser/src-jp/overlays/room_m350_cruiser/m350_callbacks.c.o(.text);
        . = ALIGN(., 4);
        room_m350_cruiser_TEXT_END = .;
        room_m350_cruiser_TEXT_SIZE = ABSOLUTE(room_m350_cruiser_TEXT_END - room_m350_cruiser_TEXT_START);
        room_m350_cruiser_DATA_START = .;
        build/JP/overlays/room_m350_cruiser/asm/JP/overlays/room_m350_cruiser/data/room_m350.rodata.s.o(.data);
        build/JP/overlays/room_m350_cruiser/src-jp/overlays/room_lib/actor_classes.c.o(.data);
        build/JP/overlays/room_m350_cruiser/asm/JP/overlays/room_m350_cruiser/data/RoomLib_HandlerCArgsData_801915BC.rodata.s.o(.data);
        build/JP/overlays/room_m350_cruiser/src-jp/overlays/room_m350_cruiser/m350.c.o(.data);
        build/JP/overlays/room_m350_cruiser/src-jp/overlays/room_m350_cruiser/RoomEffect_ConfiguredPulseCallback.c.o(.data);
        build/JP/overlays/room_m350_cruiser/src-jp/overlays/room_m350_cruiser/m350_callbacks.c.o(.data);
        build/JP/overlays/room_m350_cruiser/src-jp/overlays/room_lib/actor_class_table.c.o(.data);
        build/JP/overlays/room_m350_cruiser/asm/JP/overlays/room_m350_cruiser/data/D_8019A3C0.data.s.o(.data);
        build/JP/overlays/room_m350_cruiser/asm/JP/overlays/room_m350_cruiser/data/D_8019A3C8.data.s.o(.data);
        build/JP/overlays/room_m350_cruiser/asm/JP/overlays/room_m350_cruiser/data/D_8019A3CC.data.s.o(.data);
        build/JP/overlays/room_m350_cruiser/asm/JP/overlays/room_m350_cruiser/data/D_8019A3D0.data.s.o(.data);
        build/JP/overlays/room_m350_cruiser/asm/JP/overlays/room_m350_cruiser/data/D_8019A3D4.data.s.o(.data);
        build/JP/overlays/room_m350_cruiser/asm/JP/overlays/room_m350_cruiser/data/D_8019A410.data.s.o(.data);
        build/JP/overlays/room_m350_cruiser/asm/JP/overlays/room_m350_cruiser/data/D_8019A414.data.s.o(.data);
        build/JP/overlays/room_m350_cruiser/asm/JP/overlays/room_m350_cruiser/data/D_8019A434.data.s.o(.data);
        build/JP/overlays/room_m350_cruiser/asm/JP/overlays/room_m350_cruiser/data/D_8019A43C.data.s.o(.data);
        build/JP/overlays/room_m350_cruiser/asm/JP/overlays/room_m350_cruiser/data/D_8019A440.data.s.o(.data);
        build/JP/overlays/room_m350_cruiser/asm/JP/overlays/room_m350_cruiser/data/D_8019A458.data.s.o(.data);
        build/JP/overlays/room_m350_cruiser/asm/JP/overlays/room_m350_cruiser/data/D_8019A460.data.s.o(.data);
        build/JP/overlays/room_m350_cruiser/asm/JP/overlays/room_m350_cruiser/data/D_8019A464.data.s.o(.data);
        build/JP/overlays/room_m350_cruiser/asm/JP/overlays/room_m350_cruiser/data/D_8019A468.data.s.o(.data);
        build/JP/overlays/room_m350_cruiser/asm/JP/overlays/room_m350_cruiser/data/D_8019A4A0.data.s.o(.data);
        build/JP/overlays/room_m350_cruiser/asm/JP/overlays/room_m350_cruiser/data/D_8019A4D4.data.s.o(.data);
        build/JP/overlays/room_m350_cruiser/asm/JP/overlays/room_m350_cruiser/data/D_8019A4DC.data.s.o(.data);
        build/JP/overlays/room_m350_cruiser/asm/JP/overlays/room_m350_cruiser/data/D_8019A4E0.data.s.o(.data);
        build/JP/overlays/room_m350_cruiser/asm/JP/overlays/room_m350_cruiser/data/D_8019A4E4.data.s.o(.data);
        build/JP/overlays/room_m350_cruiser/asm/JP/overlays/room_m350_cruiser/data/D_8019A4E8.data.s.o(.data);
        build/JP/overlays/room_m350_cruiser/asm/JP/overlays/room_m350_cruiser/data/D_8019A4EC.data.s.o(.data);
        build/JP/overlays/room_m350_cruiser/asm/JP/overlays/room_m350_cruiser/data/D_8019A508.data.s.o(.data);
        build/JP/overlays/room_m350_cruiser/asm/JP/overlays/room_m350_cruiser/data/D_8019A540.data.s.o(.data);
        build/JP/overlays/room_m350_cruiser/asm/JP/overlays/room_m350_cruiser/data/D_8019A56C.data.s.o(.data);
        build/JP/overlays/room_m350_cruiser/asm/JP/overlays/room_m350_cruiser/data/D_8019A570.data.s.o(.data);
        build/JP/overlays/room_m350_cruiser/asm/JP/overlays/room_m350_cruiser/data/D_8019A574.data.s.o(.data);
        build/JP/overlays/room_m350_cruiser/asm/JP/overlays/room_m350_cruiser/data/D_8019A594.data.s.o(.data);
        build/JP/overlays/room_m350_cruiser/asm/JP/overlays/room_m350_cruiser/data/D_8019A598.data.s.o(.data);
        build/JP/overlays/room_m350_cruiser/asm/JP/overlays/room_m350_cruiser/data/D_8019A59C.data.s.o(.data);
        build/JP/overlays/room_m350_cruiser/asm/JP/overlays/room_m350_cruiser/data/D_8019A5A0.data.s.o(.data);
        build/JP/overlays/room_m350_cruiser/asm/JP/overlays/room_m350_cruiser/data/D_8019A5D8.data.s.o(.data);
        build/JP/overlays/room_m350_cruiser/asm/JP/overlays/room_m350_cruiser/data/D_8019A614.data.s.o(.data);
        build/JP/overlays/room_m350_cruiser/asm/JP/overlays/room_m350_cruiser/data/D_8019A61C.data.s.o(.data);
        build/JP/overlays/room_m350_cruiser/asm/JP/overlays/room_m350_cruiser/data/D_8019A628.data.s.o(.data);
        build/JP/overlays/room_m350_cruiser/asm/JP/overlays/room_m350_cruiser/data/D_8019A62C.data.s.o(.data);
        build/JP/overlays/room_m350_cruiser/asm/JP/overlays/room_m350_cruiser/data/D_8019A630.data.s.o(.data);
        build/JP/overlays/room_m350_cruiser/asm/JP/overlays/room_m350_cruiser/data/D_8019A634.data.s.o(.data);
        build/JP/overlays/room_m350_cruiser/asm/JP/overlays/room_m350_cruiser/data/D_8019A638.data.s.o(.data);
        build/JP/overlays/room_m350_cruiser/asm/JP/overlays/room_m350_cruiser/data/D_8019A670.data.s.o(.data);
        build/JP/overlays/room_m350_cruiser/asm/JP/overlays/room_m350_cruiser/data/D_8019A690.data.s.o(.data);
        build/JP/overlays/room_m350_cruiser/asm/JP/overlays/room_m350_cruiser/data/D_8019A6A0.data.s.o(.data);
        build/JP/overlays/room_m350_cruiser/asm/JP/overlays/room_m350_cruiser/data/D_8019A710.data.s.o(.data);
        build/JP/overlays/room_m350_cruiser/asm/JP/overlays/room_m350_cruiser/data/D_8019A734.data.s.o(.data);
        build/JP/overlays/room_m350_cruiser/asm/JP/overlays/room_m350_cruiser/data/D_8019A738.data.s.o(.data);
        build/JP/overlays/room_m350_cruiser/asm/JP/overlays/room_m350_cruiser/data/D_8019A73C.data.s.o(.data);
        build/JP/overlays/room_m350_cruiser/asm/JP/overlays/room_m350_cruiser/data/D_8019A774.data.s.o(.data);
        build/JP/overlays/room_m350_cruiser/asm/JP/overlays/room_m350_cruiser/data/D_8019A778.data.s.o(.data);
        build/JP/overlays/room_m350_cruiser/asm/JP/overlays/room_m350_cruiser/data/D_8019A798.data.s.o(.data);
        build/JP/overlays/room_m350_cruiser/asm/JP/overlays/room_m350_cruiser/data/D_8019A79C.data.s.o(.data);
        build/JP/overlays/room_m350_cruiser/asm/JP/overlays/room_m350_cruiser/data/D_8019A7A0.data.s.o(.data);
        build/JP/overlays/room_m350_cruiser/asm/JP/overlays/room_m350_cruiser/data/D_8019A7F8.data.s.o(.data);
        build/JP/overlays/room_m350_cruiser/asm/JP/overlays/room_m350_cruiser/data/D_8019A7FC.data.s.o(.data);
        build/JP/overlays/room_m350_cruiser/asm/JP/overlays/room_m350_cruiser/data/D_8019A800.data.s.o(.data);
        build/JP/overlays/room_m350_cruiser/asm/JP/overlays/room_m350_cruiser/data/D_8019A804.data.s.o(.data);
        build/JP/overlays/room_m350_cruiser/asm/JP/overlays/room_m350_cruiser/data/D_8019A808.data.s.o(.data);
        build/JP/overlays/room_m350_cruiser/asm/JP/overlays/room_m350_cruiser/data/D_8019A80C.data.s.o(.data);
        build/JP/overlays/room_m350_cruiser/asm/JP/overlays/room_m350_cruiser/data/D_8019A810.data.s.o(.data);
        build/JP/overlays/room_m350_cruiser/asm/JP/overlays/room_m350_cruiser/data/D_8019A814.data.s.o(.data);
        build/JP/overlays/room_m350_cruiser/asm/JP/overlays/room_m350_cruiser/data/D_8019A818.data.s.o(.data);
        build/JP/overlays/room_m350_cruiser/asm/JP/overlays/room_m350_cruiser/data/D_8019A81C.data.s.o(.data);
        build/JP/overlays/room_m350_cruiser/asm/JP/overlays/room_m350_cruiser/data/D_8019A820.data.s.o(.data);
        build/JP/overlays/room_m350_cruiser/asm/JP/overlays/room_m350_cruiser/data/D_8019A824.data.s.o(.data);
        build/JP/overlays/room_m350_cruiser/asm/JP/overlays/room_m350_cruiser/data/D_8019A828.data.s.o(.data);
        build/JP/overlays/room_m350_cruiser/asm/JP/overlays/room_m350_cruiser/data/D_8019A82C.data.s.o(.data);
        build/JP/overlays/room_m350_cruiser/asm/JP/overlays/room_m350_cruiser/data/D_8019A830.data.s.o(.data);
        build/JP/overlays/room_m350_cruiser/asm/JP/overlays/room_m350_cruiser/data/g_RoomEffectTrailPositions.data.s.o(.data);
        build/JP/overlays/room_m350_cruiser/asm/JP/overlays/room_m350_cruiser/data/D_8019A854.data.s.o(.data);
        build/JP/overlays/room_m350_cruiser/asm/JP/overlays/room_m350_cruiser/data/g_RoomM350DropBurstState.data.s.o(.data);
        build/JP/overlays/room_m350_cruiser/asm/JP/overlays/room_m350_cruiser/data/D_8019A85C.data.s.o(.data);
        build/JP/overlays/room_m350_cruiser/asm/JP/overlays/room_m350_cruiser/data/D_8019A860.data.s.o(.data);
        build/JP/overlays/room_m350_cruiser/asm/JP/overlays/room_m350_cruiser/data/D_8019A864.data.s.o(.data);
        build/JP/overlays/room_m350_cruiser/asm/JP/overlays/room_m350_cruiser/data/D_8019A868.data.s.o(.data);
        build/JP/overlays/room_m350_cruiser/asm/JP/overlays/room_m350_cruiser/data/D_8019A86C.data.s.o(.data);
        build/JP/overlays/room_m350_cruiser/asm/JP/overlays/room_m350_cruiser/data/D_8019A870.data.s.o(.data);
        build/JP/overlays/room_m350_cruiser/asm/JP/overlays/room_m350_cruiser/data/D_8019A874.data.s.o(.data);
        build/JP/overlays/room_m350_cruiser/asm/JP/overlays/room_m350_cruiser/data/D_8019A878.data.s.o(.data);
        build/JP/overlays/room_m350_cruiser/asm/JP/overlays/room_m350_cruiser/data/D_8019A87C.data.s.o(.data);
        build/JP/overlays/room_m350_cruiser/asm/JP/overlays/room_m350_cruiser/data/D_8019A880.data.s.o(.data);
        build/JP/overlays/room_m350_cruiser/asm/JP/overlays/room_m350_cruiser/data/D_8019A884.data.s.o(.data);
        build/JP/overlays/room_m350_cruiser/asm/JP/overlays/room_m350_cruiser/data/D_8019A888.data.s.o(.data);
        build/JP/overlays/room_m350_cruiser/asm/JP/overlays/room_m350_cruiser/data/D_8019A88C.data.s.o(.data);
        build/JP/overlays/room_m350_cruiser/asm/JP/overlays/room_m350_cruiser/data/D_8019A890.data.s.o(.data);
        build/JP/overlays/room_m350_cruiser/asm/JP/overlays/room_m350_cruiser/data/D_8019A894.data.s.o(.data);
        build/JP/overlays/room_m350_cruiser/asm/JP/overlays/room_m350_cruiser/data/D_8019A898.data.s.o(.data);
        build/JP/overlays/room_m350_cruiser/asm/JP/overlays/room_m350_cruiser/data/D_8019A89C.data.s.o(.data);
        build/JP/overlays/room_m350_cruiser/asm/JP/overlays/room_m350_cruiser/data/D_8019A8A0.data.s.o(.data);
        build/JP/overlays/room_m350_cruiser/asm/JP/overlays/room_m350_cruiser/data/D_8019A8A4.data.s.o(.data);
        build/JP/overlays/room_m350_cruiser/asm/JP/overlays/room_m350_cruiser/data/D_8019A8A8.data.s.o(.data);
        build/JP/overlays/room_m350_cruiser/asm/JP/overlays/room_m350_cruiser/data/D_8019A8B0.data.s.o(.data);
        build/JP/overlays/room_m350_cruiser/asm/JP/overlays/room_m350_cruiser/data/D_8019A8B8.data.s.o(.data);
        build/JP/overlays/room_m350_cruiser/asm/JP/overlays/room_m350_cruiser/data/D_8019A8BC.data.s.o(.data);
        build/JP/overlays/room_m350_cruiser/asm/JP/overlays/room_m350_cruiser/data/D_8019A8C0.data.s.o(.data);
        build/JP/overlays/room_m350_cruiser/asm/JP/overlays/room_m350_cruiser/data/room_m350_cruiser/D_8019A8C4.s.o(.data);
        build/JP/overlays/room_m350_cruiser/asm/JP/overlays/room_m350_cruiser/data/room_m350_cruiser/D_801B0000.s.o(.data);
        build/JP/overlays/room_m350_cruiser/asm/JP/overlays/room_m350_cruiser/data/D_801D4510.data.s.o(.data);
        build/JP/overlays/room_m350_cruiser/asm/JP/overlays/room_m350_cruiser/data/room_m350_cruiser/D_801D457C.s.o(.data);
        . = ALIGN(., 4);
        room_m350_cruiser_DATA_END = .;
        room_m350_cruiser_DATA_SIZE = ABSOLUTE(room_m350_cruiser_DATA_END - room_m350_cruiser_DATA_START);
        room_m350_cruiser_BSS_START = .;
        build/JP/overlays/room_m350_cruiser/asm/JP/overlays/room_m350_cruiser/data/room_m350.rodata.s.o(.bss);
        build/JP/overlays/room_m350_cruiser/src-jp/overlays/room_lib/actor_classes.c.o(.bss);
        build/JP/overlays/room_m350_cruiser/asm/JP/overlays/room_m350_cruiser/data/RoomLib_HandlerCArgsData_801915BC.rodata.s.o(.bss);
        build/JP/overlays/room_m350_cruiser/src-jp/overlays/room_m350_cruiser/m350.c.o(.bss);
        build/JP/overlays/room_m350_cruiser/src-jp/overlays/room_m350_cruiser/RoomEffect_ConfiguredPulseCallback.c.o(.bss);
        build/JP/overlays/room_m350_cruiser/src-jp/overlays/room_m350_cruiser/m350_callbacks.c.o(.bss);
        . = ALIGN(., 4);
        room_m350_cruiser_BSS_END = .;
        room_m350_cruiser_BSS_SIZE = ABSOLUTE(room_m350_cruiser_BSS_END - room_m350_cruiser_BSS_START);
    }
    __romPos += SIZEOF(.room_m350_cruiser);
    __romPos = ALIGN(__romPos, 4);
    . = ALIGN(., 4);
    room_m350_cruiser_ROM_END = __romPos;
    room_m350_cruiser_VRAM_END = .;

    /DISCARD/ :
    {
        *(*);
    }
}
