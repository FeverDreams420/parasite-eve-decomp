SECTIONS
{
    HIDDEN(__romPos = 0);
    room_m273_liberty_ROM_START = __romPos;
    room_m273_liberty_VRAM = ADDR(.room_m273_liberty);
    .room_m273_liberty (OVERLAY_WINDOW_ROOM + 0x0) : AT(room_m273_liberty_ROM_START) SUBALIGN(4)
    {
        FILL(0x00000000);
        room_m273_liberty_RODATA_START = .;
        build/JP/overlays/room_m273_liberty/asm/JP/overlays/room_m273_liberty/data/room_m273_liberty.rodata.s.o(.rodata);
        build/JP/overlays/room_m273_liberty/src-jp/overlays/room_lib/actor_classes.c.o(.rodata);
        build/JP/overlays/room_m273_liberty/src-jp/overlays/room_m273_liberty/m273.c.o(.rodata);
        build/JP/overlays/room_m273_liberty/asm/JP/overlays/room_m273_liberty/data/D_8018F1E4.rodata.s.o(.rodata);
        build/JP/overlays/room_m273_liberty/src-jp/overlays/room_m273_liberty/m273_class.c.o(.rodata);
        build/JP/overlays/room_m273_liberty/src-jp/overlays/room_lib/class_update_callback.c.o(.rodata);
        build/JP/overlays/room_m273_liberty/src-jp/overlays/room_lib/grab_await_stance.c.o(.rodata);
        build/JP/overlays/room_m273_liberty/src-jp/overlays/room_m273_liberty/RoomM273_PulseSpriteCallback.c.o(.rodata);
        build/JP/overlays/room_m273_liberty/src-jp/overlays/room_m273_liberty/RoomEffect_PhasedArcSpriteFlow.c.o(.rodata);
        . = ALIGN(., 4);
        room_m273_liberty_RODATA_END = .;
        room_m273_liberty_RODATA_SIZE = ABSOLUTE(room_m273_liberty_RODATA_END - room_m273_liberty_RODATA_START);
        room_m273_liberty_TEXT_START = .;
        build/JP/overlays/room_m273_liberty/src-jp/overlays/room_lib/actor_classes.c.o(.text);
        build/JP/overlays/room_m273_liberty/src-jp/overlays/room_m273_liberty/m273_class.c.o(.text);
        build/JP/overlays/room_m273_liberty/src-jp/overlays/room_lib/class_update_callback.c.o(.text);
        build/JP/overlays/room_m273_liberty/src-jp/overlays/room_lib/grab_await_stance.c.o(.text);
        build/JP/overlays/room_m273_liberty/src-jp/overlays/room_m273_liberty/m273.c.o(.text);
        build/JP/overlays/room_m273_liberty/src-jp/overlays/room_m273_liberty/RoomM273_PulseSpriteCallback.c.o(.text);
        build/JP/overlays/room_m273_liberty/src-jp/overlays/room_m273_liberty/RoomEffect_PhasedArcSpriteFlow.c.o(.text);
        . = ALIGN(., 4);
        room_m273_liberty_TEXT_END = .;
        room_m273_liberty_TEXT_SIZE = ABSOLUTE(room_m273_liberty_TEXT_END - room_m273_liberty_TEXT_START);
        room_m273_liberty_DATA_START = .;
        build/JP/overlays/room_m273_liberty/asm/JP/overlays/room_m273_liberty/data/room_m273_liberty.rodata.s.o(.data);
        build/JP/overlays/room_m273_liberty/src-jp/overlays/room_lib/actor_classes.c.o(.data);
        build/JP/overlays/room_m273_liberty/src-jp/overlays/room_m273_liberty/m273.c.o(.data);
        build/JP/overlays/room_m273_liberty/asm/JP/overlays/room_m273_liberty/data/D_8018F1E4.rodata.s.o(.data);
        build/JP/overlays/room_m273_liberty/src-jp/overlays/room_m273_liberty/m273_class.c.o(.data);
        build/JP/overlays/room_m273_liberty/src-jp/overlays/room_lib/class_update_callback.c.o(.data);
        build/JP/overlays/room_m273_liberty/src-jp/overlays/room_lib/grab_await_stance.c.o(.data);
        build/JP/overlays/room_m273_liberty/src-jp/overlays/room_m273_liberty/RoomM273_PulseSpriteCallback.c.o(.data);
        build/JP/overlays/room_m273_liberty/src-jp/overlays/room_m273_liberty/RoomEffect_PhasedArcSpriteFlow.c.o(.data);
        build/JP/overlays/room_m273_liberty/src-jp/overlays/room_lib/actor_class_table.c.o(.data);
        build/JP/overlays/room_m273_liberty/asm/JP/overlays/room_m273_liberty/data/D_8019A8B8.data.s.o(.data);
        build/JP/overlays/room_m273_liberty/asm/JP/overlays/room_m273_liberty/data/D_8019A8C8.data.s.o(.data);
        build/JP/overlays/room_m273_liberty/asm/JP/overlays/room_m273_liberty/data/D_8019A8CC.data.s.o(.data);
        build/JP/overlays/room_m273_liberty/asm/JP/overlays/room_m273_liberty/data/D_8019A8D0.data.s.o(.data);
        build/JP/overlays/room_m273_liberty/asm/JP/overlays/room_m273_liberty/data/D_8019A8D4.data.s.o(.data);
        build/JP/overlays/room_m273_liberty/asm/JP/overlays/room_m273_liberty/data/D_8019A8D8.data.s.o(.data);
        build/JP/overlays/room_m273_liberty/asm/JP/overlays/room_m273_liberty/data/D_8019A8E0.data.s.o(.data);
        build/JP/overlays/room_m273_liberty/asm/JP/overlays/room_m273_liberty/data/D_8019A8E4.data.s.o(.data);
        build/JP/overlays/room_m273_liberty/asm/JP/overlays/room_m273_liberty/data/D_8019A900.data.s.o(.data);
        build/JP/overlays/room_m273_liberty/asm/JP/overlays/room_m273_liberty/data/D_8019AB68.data.s.o(.data);
        build/JP/overlays/room_m273_liberty/asm/JP/overlays/room_m273_liberty/data/D_8019AB70.data.s.o(.data);
        build/JP/overlays/room_m273_liberty/asm/JP/overlays/room_m273_liberty/data/D_8019AB74.data.s.o(.data);
        build/JP/overlays/room_m273_liberty/asm/JP/overlays/room_m273_liberty/data/D_8019AB94.data.s.o(.data);
        build/JP/overlays/room_m273_liberty/asm/JP/overlays/room_m273_liberty/data/D_8019ABCC.data.s.o(.data);
        build/JP/overlays/room_m273_liberty/asm/JP/overlays/room_m273_liberty/data/D_8019ABFC.data.s.o(.data);
        build/JP/overlays/room_m273_liberty/asm/JP/overlays/room_m273_liberty/data/D_8019AC0C.data.s.o(.data);
        build/JP/overlays/room_m273_liberty/asm/JP/overlays/room_m273_liberty/data/D_8019AC18.data.s.o(.data);
        build/JP/overlays/room_m273_liberty/asm/JP/overlays/room_m273_liberty/data/D_8019AC20.data.s.o(.data);
        build/JP/overlays/room_m273_liberty/asm/JP/overlays/room_m273_liberty/data/D_8019AC30.data.s.o(.data);
        build/JP/overlays/room_m273_liberty/asm/JP/overlays/room_m273_liberty/data/D_8019AC40.data.s.o(.data);
        build/JP/overlays/room_m273_liberty/asm/JP/overlays/room_m273_liberty/data/D_8019AC78.data.s.o(.data);
        build/JP/overlays/room_m273_liberty/asm/JP/overlays/room_m273_liberty/data/D_8019ACA4.data.s.o(.data);
        build/JP/overlays/room_m273_liberty/asm/JP/overlays/room_m273_liberty/data/D_8019ACA8.data.s.o(.data);
        build/JP/overlays/room_m273_liberty/asm/JP/overlays/room_m273_liberty/data/D_8019ACAC.data.s.o(.data);
        build/JP/overlays/room_m273_liberty/asm/JP/overlays/room_m273_liberty/data/D_8019ACB4.data.s.o(.data);
        build/JP/overlays/room_m273_liberty/asm/JP/overlays/room_m273_liberty/data/D_8019ACBC.data.s.o(.data);
        build/JP/overlays/room_m273_liberty/asm/JP/overlays/room_m273_liberty/data/D_8019ACC0.data.s.o(.data);
        build/JP/overlays/room_m273_liberty/asm/JP/overlays/room_m273_liberty/data/D_8019ACC8.data.s.o(.data);
        build/JP/overlays/room_m273_liberty/asm/JP/overlays/room_m273_liberty/data/D_8019ACCC.data.s.o(.data);
        build/JP/overlays/room_m273_liberty/asm/JP/overlays/room_m273_liberty/data/D_8019ACDC.data.s.o(.data);
        build/JP/overlays/room_m273_liberty/asm/JP/overlays/room_m273_liberty/data/D_8019ACE0.data.s.o(.data);
        build/JP/overlays/room_m273_liberty/asm/JP/overlays/room_m273_liberty/data/D_8019ACE4.data.s.o(.data);
        build/JP/overlays/room_m273_liberty/asm/JP/overlays/room_m273_liberty/data/D_8019AD1C.data.s.o(.data);
        build/JP/overlays/room_m273_liberty/asm/JP/overlays/room_m273_liberty/data/D_8019AD54.data.s.o(.data);
        build/JP/overlays/room_m273_liberty/asm/JP/overlays/room_m273_liberty/data/D_8019AD58.data.s.o(.data);
        build/JP/overlays/room_m273_liberty/asm/JP/overlays/room_m273_liberty/data/D_8019AD5C.data.s.o(.data);
        build/JP/overlays/room_m273_liberty/asm/JP/overlays/room_m273_liberty/data/D_8019AD60.data.s.o(.data);
        build/JP/overlays/room_m273_liberty/asm/JP/overlays/room_m273_liberty/data/D_8019AD68.data.s.o(.data);
        build/JP/overlays/room_m273_liberty/asm/JP/overlays/room_m273_liberty/data/D_8019AD70.data.s.o(.data);
        build/JP/overlays/room_m273_liberty/asm/JP/overlays/room_m273_liberty/data/D_8019AD74.data.s.o(.data);
        build/JP/overlays/room_m273_liberty/asm/JP/overlays/room_m273_liberty/data/D_8019AD78.data.s.o(.data);
        build/JP/overlays/room_m273_liberty/asm/JP/overlays/room_m273_liberty/data/D_8019AD7C.data.s.o(.data);
        build/JP/overlays/room_m273_liberty/asm/JP/overlays/room_m273_liberty/data/D_8019AD80.data.s.o(.data);
        build/JP/overlays/room_m273_liberty/asm/JP/overlays/room_m273_liberty/data/D_8019AD98.data.s.o(.data);
        build/JP/overlays/room_m273_liberty/asm/JP/overlays/room_m273_liberty/data/D_8019ADD0.data.s.o(.data);
        build/JP/overlays/room_m273_liberty/asm/JP/overlays/room_m273_liberty/data/D_8019AE00.data.s.o(.data);
        build/JP/overlays/room_m273_liberty/asm/JP/overlays/room_m273_liberty/data/D_8019AE04.data.s.o(.data);
        build/JP/overlays/room_m273_liberty/asm/JP/overlays/room_m273_liberty/data/D_8019AE08.data.s.o(.data);
        build/JP/overlays/room_m273_liberty/asm/JP/overlays/room_m273_liberty/data/D_8019AE0C.data.s.o(.data);
        build/JP/overlays/room_m273_liberty/asm/JP/overlays/room_m273_liberty/data/D_8019AE10.data.s.o(.data);
        build/JP/overlays/room_m273_liberty/asm/JP/overlays/room_m273_liberty/data/D_8019AE18.data.s.o(.data);
        build/JP/overlays/room_m273_liberty/asm/JP/overlays/room_m273_liberty/data/D_8019AE1C.data.s.o(.data);
        build/JP/overlays/room_m273_liberty/asm/JP/overlays/room_m273_liberty/data/D_8019AE24.data.s.o(.data);
        build/JP/overlays/room_m273_liberty/asm/JP/overlays/room_m273_liberty/data/D_8019AE5C.data.s.o(.data);
        build/JP/overlays/room_m273_liberty/asm/JP/overlays/room_m273_liberty/data/D_8019AE60.data.s.o(.data);
        build/JP/overlays/room_m273_liberty/asm/JP/overlays/room_m273_liberty/data/D_8019AE64.data.s.o(.data);
        build/JP/overlays/room_m273_liberty/asm/JP/overlays/room_m273_liberty/data/D_8019AE68.data.s.o(.data);
        build/JP/overlays/room_m273_liberty/asm/JP/overlays/room_m273_liberty/data/D_8019AE6C.data.s.o(.data);
        build/JP/overlays/room_m273_liberty/asm/JP/overlays/room_m273_liberty/data/D_8019AE70.data.s.o(.data);
        build/JP/overlays/room_m273_liberty/asm/JP/overlays/room_m273_liberty/data/D_8019AE74.data.s.o(.data);
        build/JP/overlays/room_m273_liberty/asm/JP/overlays/room_m273_liberty/data/D_8019AE78.data.s.o(.data);
        build/JP/overlays/room_m273_liberty/asm/JP/overlays/room_m273_liberty/data/D_8019AE7C.data.s.o(.data);
        build/JP/overlays/room_m273_liberty/asm/JP/overlays/room_m273_liberty/data/D_8019AE80.data.s.o(.data);
        build/JP/overlays/room_m273_liberty/asm/JP/overlays/room_m273_liberty/data/D_8019AE84.data.s.o(.data);
        build/JP/overlays/room_m273_liberty/asm/JP/overlays/room_m273_liberty/data/D_8019AE88.data.s.o(.data);
        build/JP/overlays/room_m273_liberty/asm/JP/overlays/room_m273_liberty/data/D_8019AE8C.data.s.o(.data);
        build/JP/overlays/room_m273_liberty/asm/JP/overlays/room_m273_liberty/data/D_8019AE90.data.s.o(.data);
        build/JP/overlays/room_m273_liberty/asm/JP/overlays/room_m273_liberty/data/D_8019AE94.data.s.o(.data);
        build/JP/overlays/room_m273_liberty/asm/JP/overlays/room_m273_liberty/data/D_8019AE98.data.s.o(.data);
        build/JP/overlays/room_m273_liberty/asm/JP/overlays/room_m273_liberty/data/D_8019AE9C.data.s.o(.data);
        build/JP/overlays/room_m273_liberty/asm/JP/overlays/room_m273_liberty/data/D_8019AEA0.data.s.o(.data);
        build/JP/overlays/room_m273_liberty/asm/JP/overlays/room_m273_liberty/data/D_8019AEAC.data.s.o(.data);
        build/JP/overlays/room_m273_liberty/asm/JP/overlays/room_m273_liberty/data/D_8019AEB4.data.s.o(.data);
        build/JP/overlays/room_m273_liberty/asm/JP/overlays/room_m273_liberty/data/D_8019AEE8.data.s.o(.data);
        build/JP/overlays/room_m273_liberty/asm/JP/overlays/room_m273_liberty/data/D_8019AEEC.data.s.o(.data);
        build/JP/overlays/room_m273_liberty/asm/JP/overlays/room_m273_liberty/data/D_8019AEF0.data.s.o(.data);
        build/JP/overlays/room_m273_liberty/asm/JP/overlays/room_m273_liberty/data/D_8019AEF4.data.s.o(.data);
        build/JP/overlays/room_m273_liberty/asm/JP/overlays/room_m273_liberty/data/D_8019AEF8.data.s.o(.data);
        build/JP/overlays/room_m273_liberty/asm/JP/overlays/room_m273_liberty/data/D_8019AEFC.data.s.o(.data);
        build/JP/overlays/room_m273_liberty/asm/JP/overlays/room_m273_liberty/data/D_8019AF00.data.s.o(.data);
        build/JP/overlays/room_m273_liberty/asm/JP/overlays/room_m273_liberty/data/D_8019AF04.data.s.o(.data);
        build/JP/overlays/room_m273_liberty/asm/JP/overlays/room_m273_liberty/data/D_8019AF54.data.s.o(.data);
        build/JP/overlays/room_m273_liberty/asm/JP/overlays/room_m273_liberty/data/D_8019AF58.data.s.o(.data);
        build/JP/overlays/room_m273_liberty/asm/JP/overlays/room_m273_liberty/data/D_8019AF5C.data.s.o(.data);
        build/JP/overlays/room_m273_liberty/asm/JP/overlays/room_m273_liberty/data/D_8019AF60.data.s.o(.data);
        build/JP/overlays/room_m273_liberty/asm/JP/overlays/room_m273_liberty/data/D_8019AF64.data.s.o(.data);
        build/JP/overlays/room_m273_liberty/asm/JP/overlays/room_m273_liberty/data/D_8019AF68.data.s.o(.data);
        build/JP/overlays/room_m273_liberty/asm/JP/overlays/room_m273_liberty/data/D_8019AF6C.data.s.o(.data);
        build/JP/overlays/room_m273_liberty/asm/JP/overlays/room_m273_liberty/data/D_8019AF70.data.s.o(.data);
        build/JP/overlays/room_m273_liberty/asm/JP/overlays/room_m273_liberty/data/D_8019AF74.data.s.o(.data);
        build/JP/overlays/room_m273_liberty/asm/JP/overlays/room_m273_liberty/data/D_8019AF78.data.s.o(.data);
        build/JP/overlays/room_m273_liberty/asm/JP/overlays/room_m273_liberty/data/D_8019AF7C.data.s.o(.data);
        build/JP/overlays/room_m273_liberty/asm/JP/overlays/room_m273_liberty/data/D_8019AF80.data.s.o(.data);
        build/JP/overlays/room_m273_liberty/asm/JP/overlays/room_m273_liberty/data/D_8019AF84.data.s.o(.data);
        build/JP/overlays/room_m273_liberty/asm/JP/overlays/room_m273_liberty/data/D_8019AF88.data.s.o(.data);
        build/JP/overlays/room_m273_liberty/asm/JP/overlays/room_m273_liberty/data/D_8019AF94.data.s.o(.data);
        build/JP/overlays/room_m273_liberty/asm/JP/overlays/room_m273_liberty/data/D_8019AF98.data.s.o(.data);
        build/JP/overlays/room_m273_liberty/asm/JP/overlays/room_m273_liberty/data/D_8019AF9C.data.s.o(.data);
        build/JP/overlays/room_m273_liberty/asm/JP/overlays/room_m273_liberty/data/room_m273_liberty/D_8019AFA0.s.o(.data);
        build/JP/overlays/room_m273_liberty/asm/JP/overlays/room_m273_liberty/data/room_m273_liberty/D_801D01E8.s.o(.data);
        build/JP/overlays/room_m273_liberty/asm/JP/overlays/room_m273_liberty/data/D_801DEDB4.data.s.o(.data);
        build/JP/overlays/room_m273_liberty/asm/JP/overlays/room_m273_liberty/data/room_m273_liberty/D_801DEE2C.s.o(.data);
        . = ALIGN(., 4);
        room_m273_liberty_DATA_END = .;
        room_m273_liberty_DATA_SIZE = ABSOLUTE(room_m273_liberty_DATA_END - room_m273_liberty_DATA_START);
        room_m273_liberty_BSS_START = .;
        build/JP/overlays/room_m273_liberty/asm/JP/overlays/room_m273_liberty/data/room_m273_liberty.rodata.s.o(.bss);
        build/JP/overlays/room_m273_liberty/src-jp/overlays/room_lib/actor_classes.c.o(.bss);
        build/JP/overlays/room_m273_liberty/src-jp/overlays/room_m273_liberty/m273.c.o(.bss);
        build/JP/overlays/room_m273_liberty/asm/JP/overlays/room_m273_liberty/data/D_8018F1E4.rodata.s.o(.bss);
        build/JP/overlays/room_m273_liberty/src-jp/overlays/room_m273_liberty/m273_class.c.o(.bss);
        build/JP/overlays/room_m273_liberty/src-jp/overlays/room_lib/class_update_callback.c.o(.bss);
        build/JP/overlays/room_m273_liberty/src-jp/overlays/room_lib/grab_await_stance.c.o(.bss);
        build/JP/overlays/room_m273_liberty/src-jp/overlays/room_m273_liberty/RoomM273_PulseSpriteCallback.c.o(.bss);
        build/JP/overlays/room_m273_liberty/src-jp/overlays/room_m273_liberty/RoomEffect_PhasedArcSpriteFlow.c.o(.bss);
        . = ALIGN(., 4);
        room_m273_liberty_BSS_END = .;
        room_m273_liberty_BSS_SIZE = ABSOLUTE(room_m273_liberty_BSS_END - room_m273_liberty_BSS_START);
    }
    __romPos += SIZEOF(.room_m273_liberty);
    __romPos = ALIGN(__romPos, 4);
    . = ALIGN(., 4);
    room_m273_liberty_ROM_END = __romPos;
    room_m273_liberty_VRAM_END = .;

    /DISCARD/ :
    {
        *(*);
    }
}
