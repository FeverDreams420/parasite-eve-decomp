SECTIONS
{
    HIDDEN(__romPos = 0);
    room_m393_chrysler_ROM_START = __romPos;
    room_m393_chrysler_VRAM = ADDR(.room_m393_chrysler);
    .room_m393_chrysler (OVERLAY_WINDOW_ROOM + 0x0) : AT(room_m393_chrysler_ROM_START) SUBALIGN(4)
    {
        FILL(0x00000000);
        room_m393_chrysler_RODATA_START = .;
        build/JP/overlays/room_m393_chrysler/asm/JP/overlays/room_m393_chrysler/data/room_m393_chrysler.rodata.s.o(.rodata);
        build/JP/overlays/room_m393_chrysler/src/jp/overlays/room_lib/three_particles.c.o(.rodata);
        build/JP/overlays/room_m393_chrysler/src/jp/overlays/room_lib/falling_sprite_burst.c.o(.rodata);
        build/JP/overlays/room_m393_chrysler/src/jp/overlays/room_lib/actor_classes.c.o(.rodata);
        build/JP/overlays/room_m393_chrysler/asm/JP/overlays/room_m393_chrysler/data/RoomLib_HandlerCArgsData_801936F4.rodata.s.o(.rodata);
        build/JP/overlays/room_m393_chrysler/src/jp/overlays/room_lib/class_nop0.c.o(.rodata);
        build/JP/overlays/room_m393_chrysler/src/jp/overlays/room_lib/class_plant_script.c.o(.rodata);
        build/JP/overlays/room_m393_chrysler/src/jp/overlays/room_lib/class_spawn.c.o(.rodata);
        build/JP/overlays/room_m393_chrysler/src/jp/overlays/room_lib/class_register_draw_list.c.o(.rodata);
        build/JP/overlays/room_m393_chrysler/src/jp/overlays/room_lib/class_register_tables.c.o(.rodata);
        build/JP/overlays/room_m393_chrysler/src/jp/overlays/room_lib/class_close_target.c.o(.rodata);
        build/JP/overlays/room_m393_chrysler/src/jp/overlays/room_lib/class_nop6.c.o(.rodata);
        . = ALIGN(., 4);
        room_m393_chrysler_RODATA_END = .;
        room_m393_chrysler_RODATA_SIZE = ABSOLUTE(room_m393_chrysler_RODATA_END - room_m393_chrysler_RODATA_START);
        room_m393_chrysler_TEXT_START = .;
        build/JP/overlays/room_m393_chrysler/src/jp/overlays/room_lib/three_particles.c.o(.text);
        build/JP/overlays/room_m393_chrysler/src/jp/overlays/room_lib/class_nop0.c.o(.text);
        build/JP/overlays/room_m393_chrysler/src/jp/overlays/room_lib/class_plant_script.c.o(.text);
        build/JP/overlays/room_m393_chrysler/src/jp/overlays/room_lib/class_spawn.c.o(.text);
        build/JP/overlays/room_m393_chrysler/src/jp/overlays/room_lib/class_register_draw_list.c.o(.text);
        build/JP/overlays/room_m393_chrysler/src/jp/overlays/room_lib/class_register_tables.c.o(.text);
        build/JP/overlays/room_m393_chrysler/src/jp/overlays/room_lib/class_close_target.c.o(.text);
        build/JP/overlays/room_m393_chrysler/src/jp/overlays/room_lib/class_nop6.c.o(.text);
        build/JP/overlays/room_m393_chrysler/src/jp/overlays/room_lib/falling_sprite_burst.c.o(.text);
        build/JP/overlays/room_m393_chrysler/src/jp/overlays/room_lib/actor_classes.c.o(.text);
        . = ALIGN(., 4);
        room_m393_chrysler_TEXT_END = .;
        room_m393_chrysler_TEXT_SIZE = ABSOLUTE(room_m393_chrysler_TEXT_END - room_m393_chrysler_TEXT_START);
        room_m393_chrysler_DATA_START = .;
        build/JP/overlays/room_m393_chrysler/asm/JP/overlays/room_m393_chrysler/data/room_m393_chrysler.rodata.s.o(.data);
        build/JP/overlays/room_m393_chrysler/src/jp/overlays/room_lib/three_particles.c.o(.data);
        build/JP/overlays/room_m393_chrysler/src/jp/overlays/room_lib/falling_sprite_burst.c.o(.data);
        build/JP/overlays/room_m393_chrysler/src/jp/overlays/room_lib/actor_classes.c.o(.data);
        build/JP/overlays/room_m393_chrysler/asm/JP/overlays/room_m393_chrysler/data/RoomLib_HandlerCArgsData_801936F4.rodata.s.o(.data);
        build/JP/overlays/room_m393_chrysler/src/jp/overlays/room_lib/class_nop0.c.o(.data);
        build/JP/overlays/room_m393_chrysler/src/jp/overlays/room_lib/class_plant_script.c.o(.data);
        build/JP/overlays/room_m393_chrysler/src/jp/overlays/room_lib/class_spawn.c.o(.data);
        build/JP/overlays/room_m393_chrysler/src/jp/overlays/room_lib/class_register_draw_list.c.o(.data);
        build/JP/overlays/room_m393_chrysler/src/jp/overlays/room_lib/class_register_tables.c.o(.data);
        build/JP/overlays/room_m393_chrysler/src/jp/overlays/room_lib/class_close_target.c.o(.data);
        build/JP/overlays/room_m393_chrysler/src/jp/overlays/room_lib/class_nop6.c.o(.data);
        build/JP/overlays/room_m393_chrysler/asm/JP/overlays/room_m393_chrysler/data/D_80194640.data.s.o(.data);
        build/JP/overlays/room_m393_chrysler/asm/JP/overlays/room_m393_chrysler/data/RoomLib_TableA_8018F264.data.s.o(.data);
        build/JP/overlays/room_m393_chrysler/asm/JP/overlays/room_m393_chrysler/data/D_80194658.data.s.o(.data);
        build/JP/overlays/room_m393_chrysler/asm/JP/overlays/room_m393_chrysler/data/D_80194664.data.s.o(.data);
        build/JP/overlays/room_m393_chrysler/asm/JP/overlays/room_m393_chrysler/data/D_8019466C.data.s.o(.data);
        build/JP/overlays/room_m393_chrysler/asm/JP/overlays/room_m393_chrysler/data/D_80194688.data.s.o(.data);
        build/JP/overlays/room_m393_chrysler/asm/JP/overlays/room_m393_chrysler/data/D_801946C0.data.s.o(.data);
        build/JP/overlays/room_m393_chrysler/asm/JP/overlays/room_m393_chrysler/data/D_801946D0.data.s.o(.data);
        build/JP/overlays/room_m393_chrysler/asm/JP/overlays/room_m393_chrysler/data/RoomLib_TableA_80190268.data.s.o(.data);
        build/JP/overlays/room_m393_chrysler/asm/JP/overlays/room_m393_chrysler/data/D_80194700.data.s.o(.data);
        build/JP/overlays/room_m393_chrysler/asm/JP/overlays/room_m393_chrysler/data/D_80194718.data.s.o(.data);
        build/JP/overlays/room_m393_chrysler/asm/JP/overlays/room_m393_chrysler/data/D_80194724.data.s.o(.data);
        build/JP/overlays/room_m393_chrysler/asm/JP/overlays/room_m393_chrysler/data/RoomLib_TableB_80190210.data.s.o(.data);
        build/JP/overlays/room_m393_chrysler/src/jp/overlays/room_lib/actor_class_table.c.o(.data);
        build/JP/overlays/room_m393_chrysler/asm/JP/overlays/room_m393_chrysler/data/D_80194834.data.s.o(.data);
        build/JP/overlays/room_m393_chrysler/asm/JP/overlays/room_m393_chrysler/data/D_80194838.data.s.o(.data);
        build/JP/overlays/room_m393_chrysler/asm/JP/overlays/room_m393_chrysler/data/D_8019483C.data.s.o(.data);
        build/JP/overlays/room_m393_chrysler/asm/JP/overlays/room_m393_chrysler/data/D_80194840.data.s.o(.data);
        build/JP/overlays/room_m393_chrysler/asm/JP/overlays/room_m393_chrysler/data/D_80194848.data.s.o(.data);
        build/JP/overlays/room_m393_chrysler/asm/JP/overlays/room_m393_chrysler/data/D_8019484C.data.s.o(.data);
        build/JP/overlays/room_m393_chrysler/asm/JP/overlays/room_m393_chrysler/data/D_80194850.data.s.o(.data);
        build/JP/overlays/room_m393_chrysler/asm/JP/overlays/room_m393_chrysler/data/D_80194858.data.s.o(.data);
        build/JP/overlays/room_m393_chrysler/asm/JP/overlays/room_m393_chrysler/data/D_8019485C.data.s.o(.data);
        build/JP/overlays/room_m393_chrysler/asm/JP/overlays/room_m393_chrysler/data/D_80194860.data.s.o(.data);
        build/JP/overlays/room_m393_chrysler/asm/JP/overlays/room_m393_chrysler/data/D_80194868.data.s.o(.data);
        build/JP/overlays/room_m393_chrysler/asm/JP/overlays/room_m393_chrysler/data/D_8019486C.data.s.o(.data);
        build/JP/overlays/room_m393_chrysler/asm/JP/overlays/room_m393_chrysler/data/D_80194870.data.s.o(.data);
        build/JP/overlays/room_m393_chrysler/asm/JP/overlays/room_m393_chrysler/data/D_80194878.data.s.o(.data);
        build/JP/overlays/room_m393_chrysler/asm/JP/overlays/room_m393_chrysler/data/D_8019487C.data.s.o(.data);
        build/JP/overlays/room_m393_chrysler/asm/JP/overlays/room_m393_chrysler/data/D_80194880.data.s.o(.data);
        build/JP/overlays/room_m393_chrysler/asm/JP/overlays/room_m393_chrysler/data/D_80194888.data.s.o(.data);
        build/JP/overlays/room_m393_chrysler/asm/JP/overlays/room_m393_chrysler/data/D_8019488C.data.s.o(.data);
        build/JP/overlays/room_m393_chrysler/asm/JP/overlays/room_m393_chrysler/data/D_80194890.data.s.o(.data);
        build/JP/overlays/room_m393_chrysler/asm/JP/overlays/room_m393_chrysler/data/D_80194898.data.s.o(.data);
        build/JP/overlays/room_m393_chrysler/asm/JP/overlays/room_m393_chrysler/data/D_8019489C.data.s.o(.data);
        build/JP/overlays/room_m393_chrysler/asm/JP/overlays/room_m393_chrysler/data/room_m393_chrysler/D_801948A0.s.o(.data);
        build/JP/overlays/room_m393_chrysler/asm/JP/overlays/room_m393_chrysler/data/D_801C01E4.data.s.o(.data);
        . = ALIGN(., 4);
        room_m393_chrysler_DATA_END = .;
        room_m393_chrysler_DATA_SIZE = ABSOLUTE(room_m393_chrysler_DATA_END - room_m393_chrysler_DATA_START);
        room_m393_chrysler_BSS_START = .;
        build/JP/overlays/room_m393_chrysler/asm/JP/overlays/room_m393_chrysler/data/room_m393_chrysler.rodata.s.o(.bss);
        build/JP/overlays/room_m393_chrysler/src/jp/overlays/room_lib/three_particles.c.o(.bss);
        build/JP/overlays/room_m393_chrysler/src/jp/overlays/room_lib/falling_sprite_burst.c.o(.bss);
        build/JP/overlays/room_m393_chrysler/src/jp/overlays/room_lib/actor_classes.c.o(.bss);
        build/JP/overlays/room_m393_chrysler/asm/JP/overlays/room_m393_chrysler/data/RoomLib_HandlerCArgsData_801936F4.rodata.s.o(.bss);
        build/JP/overlays/room_m393_chrysler/src/jp/overlays/room_lib/class_nop0.c.o(.bss);
        build/JP/overlays/room_m393_chrysler/src/jp/overlays/room_lib/class_plant_script.c.o(.bss);
        build/JP/overlays/room_m393_chrysler/src/jp/overlays/room_lib/class_spawn.c.o(.bss);
        build/JP/overlays/room_m393_chrysler/src/jp/overlays/room_lib/class_register_draw_list.c.o(.bss);
        build/JP/overlays/room_m393_chrysler/src/jp/overlays/room_lib/class_register_tables.c.o(.bss);
        build/JP/overlays/room_m393_chrysler/src/jp/overlays/room_lib/class_close_target.c.o(.bss);
        build/JP/overlays/room_m393_chrysler/src/jp/overlays/room_lib/class_nop6.c.o(.bss);
        . = ALIGN(., 4);
        room_m393_chrysler_BSS_END = .;
        room_m393_chrysler_BSS_SIZE = ABSOLUTE(room_m393_chrysler_BSS_END - room_m393_chrysler_BSS_START);
    }
    __romPos += SIZEOF(.room_m393_chrysler);
    __romPos = ALIGN(__romPos, 4);
    . = ALIGN(., 4);
    room_m393_chrysler_ROM_END = __romPos;
    room_m393_chrysler_VRAM_END = .;

    /DISCARD/ :
    {
        *(*);
    }
}
