SECTIONS
{
    HIDDEN(__romPos = 0);
    room_m174_sewer2_ROM_START = __romPos;
    room_m174_sewer2_VRAM = ADDR(.room_m174_sewer2);
    .room_m174_sewer2 (OVERLAY_WINDOW_ROOM + 0x0) : AT(room_m174_sewer2_ROM_START) SUBALIGN(4)
    {
        FILL(0x00000000);
        room_m174_sewer2_RODATA_START = .;
        build/JP/overlays/room_m174_sewer2/asm/JP/overlays/room_m174_sewer2/data/room_m174_sewer2.rodata.s.o(.rodata);
        build/JP/overlays/room_m174_sewer2/src/jp/overlays/room_lib/glow_orb.c.o(.rodata);
        build/JP/overlays/room_m174_sewer2/src/jp/overlays/room_lib/drop_field.c.o(.rodata);
        build/JP/overlays/room_m174_sewer2/src/jp/overlays/room_lib/actor_classes.c.o(.rodata);
        build/JP/overlays/room_m174_sewer2/src/jp/overlays/room_lib/glow_orb_setup.c.o(.rodata);
        build/JP/overlays/room_m174_sewer2/src/jp/overlays/room_lib/class_spawn.c.o(.rodata);
        build/JP/overlays/room_m174_sewer2/src/jp/overlays/room_lib/class_register_active.c.o(.rodata);
        build/JP/overlays/room_m174_sewer2/src/jp/overlays/room_lib/class_close_target.c.o(.rodata);
        . = ALIGN(., 4);
        room_m174_sewer2_RODATA_END = .;
        room_m174_sewer2_RODATA_SIZE = ABSOLUTE(room_m174_sewer2_RODATA_END - room_m174_sewer2_RODATA_START);
        room_m174_sewer2_TEXT_START = .;
        build/JP/overlays/room_m174_sewer2/src/jp/overlays/room_lib/glow_orb_setup.c.o(.text);
        build/JP/overlays/room_m174_sewer2/src/jp/overlays/room_lib/class_spawn.c.o(.text);
        build/JP/overlays/room_m174_sewer2/src/jp/overlays/room_lib/class_register_active.c.o(.text);
        build/JP/overlays/room_m174_sewer2/src/jp/overlays/room_lib/class_close_target.c.o(.text);
        build/JP/overlays/room_m174_sewer2/src/jp/overlays/room_lib/glow_orb.c.o(.text);
        build/JP/overlays/room_m174_sewer2/src/jp/overlays/room_lib/drop_field.c.o(.text);
        build/JP/overlays/room_m174_sewer2/src/jp/overlays/room_lib/actor_classes.c.o(.text);
        . = ALIGN(., 4);
        room_m174_sewer2_TEXT_END = .;
        room_m174_sewer2_TEXT_SIZE = ABSOLUTE(room_m174_sewer2_TEXT_END - room_m174_sewer2_TEXT_START);
        room_m174_sewer2_DATA_START = .;
        build/JP/overlays/room_m174_sewer2/asm/JP/overlays/room_m174_sewer2/data/room_m174_sewer2.rodata.s.o(.data);
        build/JP/overlays/room_m174_sewer2/src/jp/overlays/room_lib/glow_orb.c.o(.data);
        build/JP/overlays/room_m174_sewer2/src/jp/overlays/room_lib/drop_field.c.o(.data);
        build/JP/overlays/room_m174_sewer2/src/jp/overlays/room_lib/actor_classes.c.o(.data);
        build/JP/overlays/room_m174_sewer2/src/jp/overlays/room_lib/glow_orb_setup.c.o(.data);
        build/JP/overlays/room_m174_sewer2/src/jp/overlays/room_lib/class_spawn.c.o(.data);
        build/JP/overlays/room_m174_sewer2/src/jp/overlays/room_lib/class_register_active.c.o(.data);
        build/JP/overlays/room_m174_sewer2/src/jp/overlays/room_lib/class_close_target.c.o(.data);
        build/JP/overlays/room_m174_sewer2/asm/JP/overlays/room_m174_sewer2/data/D_80196C7C.data.s.o(.data);
        build/JP/overlays/room_m174_sewer2/asm/JP/overlays/room_m174_sewer2/data/RoomLib_TableC.data.s.o(.data);
        build/JP/overlays/room_m174_sewer2/asm/JP/overlays/room_m174_sewer2/data/D_80196CA4.data.s.o(.data);
        build/JP/overlays/room_m174_sewer2/asm/JP/overlays/room_m174_sewer2/data/D_80196CB8.data.s.o(.data);
        build/JP/overlays/room_m174_sewer2/asm/JP/overlays/room_m174_sewer2/data/D_80196CC4.data.s.o(.data);
        build/JP/overlays/room_m174_sewer2/asm/JP/overlays/room_m174_sewer2/data/D_80196CE0.data.s.o(.data);
        build/JP/overlays/room_m174_sewer2/asm/JP/overlays/room_m174_sewer2/data/D_80196D6C.data.s.o(.data);
        build/JP/overlays/room_m174_sewer2/asm/JP/overlays/room_m174_sewer2/data/D_80196DA4.data.s.o(.data);
        build/JP/overlays/room_m174_sewer2/asm/JP/overlays/room_m174_sewer2/data/D_80196DDC.data.s.o(.data);
        build/JP/overlays/room_m174_sewer2/asm/JP/overlays/room_m174_sewer2/data/D_80196E14.data.s.o(.data);
        build/JP/overlays/room_m174_sewer2/asm/JP/overlays/room_m174_sewer2/data/D_80196E30.data.s.o(.data);
        build/JP/overlays/room_m174_sewer2/asm/JP/overlays/room_m174_sewer2/data/RoomLib_TableB_80190184.data.s.o(.data);
        build/JP/overlays/room_m174_sewer2/asm/JP/overlays/room_m174_sewer2/data/D_80196F0C.data.s.o(.data);
        build/JP/overlays/room_m174_sewer2/src/jp/overlays/room_lib/actor_class_table.c.o(.data);
        build/JP/overlays/room_m174_sewer2/asm/JP/overlays/room_m174_sewer2/data/D_80196FC8.data.s.o(.data);
        build/JP/overlays/room_m174_sewer2/asm/JP/overlays/room_m174_sewer2/data/D_80196FE8.data.s.o(.data);
        build/JP/overlays/room_m174_sewer2/asm/JP/overlays/room_m174_sewer2/data/D_801971E8.data.s.o(.data);
        build/JP/overlays/room_m174_sewer2/asm/JP/overlays/room_m174_sewer2/data/D_801973E8.data.s.o(.data);
        build/JP/overlays/room_m174_sewer2/asm/JP/overlays/room_m174_sewer2/data/D_801973EC.data.s.o(.data);
        build/JP/overlays/room_m174_sewer2/asm/JP/overlays/room_m174_sewer2/data/D_801973F0.data.s.o(.data);
        build/JP/overlays/room_m174_sewer2/asm/JP/overlays/room_m174_sewer2/data/D_801973F8.data.s.o(.data);
        build/JP/overlays/room_m174_sewer2/asm/JP/overlays/room_m174_sewer2/data/D_801973FC.data.s.o(.data);
        build/JP/overlays/room_m174_sewer2/asm/JP/overlays/room_m174_sewer2/data/D_80197400.data.s.o(.data);
        build/JP/overlays/room_m174_sewer2/asm/JP/overlays/room_m174_sewer2/data/D_80197404.data.s.o(.data);
        build/JP/overlays/room_m174_sewer2/asm/JP/overlays/room_m174_sewer2/data/D_80197408.data.s.o(.data);
        build/JP/overlays/room_m174_sewer2/asm/JP/overlays/room_m174_sewer2/data/D_80197410.data.s.o(.data);
        build/JP/overlays/room_m174_sewer2/asm/JP/overlays/room_m174_sewer2/data/D_80197414.data.s.o(.data);
        build/JP/overlays/room_m174_sewer2/asm/JP/overlays/room_m174_sewer2/data/D_80197418.data.s.o(.data);
        build/JP/overlays/room_m174_sewer2/asm/JP/overlays/room_m174_sewer2/data/D_80197424.data.s.o(.data);
        build/JP/overlays/room_m174_sewer2/asm/JP/overlays/room_m174_sewer2/data/D_80197428.data.s.o(.data);
        build/JP/overlays/room_m174_sewer2/asm/JP/overlays/room_m174_sewer2/data/D_80197430.data.s.o(.data);
        build/JP/overlays/room_m174_sewer2/asm/JP/overlays/room_m174_sewer2/data/D_80197434.data.s.o(.data);
        build/JP/overlays/room_m174_sewer2/asm/JP/overlays/room_m174_sewer2/data/D_80197438.data.s.o(.data);
        build/JP/overlays/room_m174_sewer2/asm/JP/overlays/room_m174_sewer2/data/D_80197440.data.s.o(.data);
        build/JP/overlays/room_m174_sewer2/asm/JP/overlays/room_m174_sewer2/data/D_80197444.data.s.o(.data);
        build/JP/overlays/room_m174_sewer2/asm/JP/overlays/room_m174_sewer2/data/D_80197448.data.s.o(.data);
        build/JP/overlays/room_m174_sewer2/asm/JP/overlays/room_m174_sewer2/data/D_80197450.data.s.o(.data);
        build/JP/overlays/room_m174_sewer2/asm/JP/overlays/room_m174_sewer2/data/D_80197454.data.s.o(.data);
        build/JP/overlays/room_m174_sewer2/asm/JP/overlays/room_m174_sewer2/data/D_80197458.data.s.o(.data);
        build/JP/overlays/room_m174_sewer2/asm/JP/overlays/room_m174_sewer2/data/D_80197464.data.s.o(.data);
        build/JP/overlays/room_m174_sewer2/asm/JP/overlays/room_m174_sewer2/data/D_80197468.data.s.o(.data);
        build/JP/overlays/room_m174_sewer2/asm/JP/overlays/room_m174_sewer2/data/D_8019746C.data.s.o(.data);
        build/JP/overlays/room_m174_sewer2/asm/JP/overlays/room_m174_sewer2/data/D_80197470.data.s.o(.data);
        build/JP/overlays/room_m174_sewer2/asm/JP/overlays/room_m174_sewer2/data/D_80197474.data.s.o(.data);
        build/JP/overlays/room_m174_sewer2/asm/JP/overlays/room_m174_sewer2/data/D_8019748C.data.s.o(.data);
        build/JP/overlays/room_m174_sewer2/asm/JP/overlays/room_m174_sewer2/data/D_80197494.data.s.o(.data);
        build/JP/overlays/room_m174_sewer2/asm/JP/overlays/room_m174_sewer2/data/D_80197498.data.s.o(.data);
        build/JP/overlays/room_m174_sewer2/asm/JP/overlays/room_m174_sewer2/data/D_8019749C.data.s.o(.data);
        build/JP/overlays/room_m174_sewer2/asm/JP/overlays/room_m174_sewer2/data/D_801974A0.data.s.o(.data);
        build/JP/overlays/room_m174_sewer2/asm/JP/overlays/room_m174_sewer2/data/D_801974A4.data.s.o(.data);
        build/JP/overlays/room_m174_sewer2/asm/JP/overlays/room_m174_sewer2/data/D_801974AC.data.s.o(.data);
        build/JP/overlays/room_m174_sewer2/asm/JP/overlays/room_m174_sewer2/data/D_801974B0.data.s.o(.data);
        build/JP/overlays/room_m174_sewer2/asm/JP/overlays/room_m174_sewer2/data/D_801974B4.data.s.o(.data);
        build/JP/overlays/room_m174_sewer2/asm/JP/overlays/room_m174_sewer2/data/D_801974B8.data.s.o(.data);
        build/JP/overlays/room_m174_sewer2/asm/JP/overlays/room_m174_sewer2/data/D_801974BC.data.s.o(.data);
        build/JP/overlays/room_m174_sewer2/asm/JP/overlays/room_m174_sewer2/data/D_801974C0.data.s.o(.data);
        build/JP/overlays/room_m174_sewer2/asm/JP/overlays/room_m174_sewer2/data/D_801974C4.data.s.o(.data);
        build/JP/overlays/room_m174_sewer2/asm/JP/overlays/room_m174_sewer2/data/D_801974C8.data.s.o(.data);
        build/JP/overlays/room_m174_sewer2/asm/JP/overlays/room_m174_sewer2/data/D_801974D0.data.s.o(.data);
        build/JP/overlays/room_m174_sewer2/asm/JP/overlays/room_m174_sewer2/data/D_801974D4.data.s.o(.data);
        build/JP/overlays/room_m174_sewer2/asm/JP/overlays/room_m174_sewer2/data/D_801974D8.data.s.o(.data);
        build/JP/overlays/room_m174_sewer2/asm/JP/overlays/room_m174_sewer2/data/D_801974E0.data.s.o(.data);
        build/JP/overlays/room_m174_sewer2/asm/JP/overlays/room_m174_sewer2/data/D_801974F4.data.s.o(.data);
        build/JP/overlays/room_m174_sewer2/asm/JP/overlays/room_m174_sewer2/data/room_m174_sewer2/D_801974FC.s.o(.data);
        build/JP/overlays/room_m174_sewer2/asm/JP/overlays/room_m174_sewer2/data/D_801C01E0.data.s.o(.data);
        build/JP/overlays/room_m174_sewer2/asm/JP/overlays/room_m174_sewer2/data/D_801C01E4.data.s.o(.data);
        build/JP/overlays/room_m174_sewer2/asm/JP/overlays/room_m174_sewer2/data/D_801C01EC.data.s.o(.data);
        build/JP/overlays/room_m174_sewer2/asm/JP/overlays/room_m174_sewer2/data/room_m174_sewer2/D_801C01F8.s.o(.data);
        build/JP/overlays/room_m174_sewer2/asm/JP/overlays/room_m174_sewer2/data/D_801CCA84.data.s.o(.data);
        build/JP/overlays/room_m174_sewer2/asm/JP/overlays/room_m174_sewer2/data/room_m174_sewer2/D_801CCAA8.s.o(.data);
        . = ALIGN(., 4);
        room_m174_sewer2_DATA_END = .;
        room_m174_sewer2_DATA_SIZE = ABSOLUTE(room_m174_sewer2_DATA_END - room_m174_sewer2_DATA_START);
        room_m174_sewer2_BSS_START = .;
        build/JP/overlays/room_m174_sewer2/asm/JP/overlays/room_m174_sewer2/data/room_m174_sewer2.rodata.s.o(.bss);
        build/JP/overlays/room_m174_sewer2/src/jp/overlays/room_lib/glow_orb.c.o(.bss);
        build/JP/overlays/room_m174_sewer2/src/jp/overlays/room_lib/drop_field.c.o(.bss);
        build/JP/overlays/room_m174_sewer2/src/jp/overlays/room_lib/actor_classes.c.o(.bss);
        build/JP/overlays/room_m174_sewer2/src/jp/overlays/room_lib/glow_orb_setup.c.o(.bss);
        build/JP/overlays/room_m174_sewer2/src/jp/overlays/room_lib/class_spawn.c.o(.bss);
        build/JP/overlays/room_m174_sewer2/src/jp/overlays/room_lib/class_register_active.c.o(.bss);
        build/JP/overlays/room_m174_sewer2/src/jp/overlays/room_lib/class_close_target.c.o(.bss);
        . = ALIGN(., 4);
        room_m174_sewer2_BSS_END = .;
        room_m174_sewer2_BSS_SIZE = ABSOLUTE(room_m174_sewer2_BSS_END - room_m174_sewer2_BSS_START);
    }
    __romPos += SIZEOF(.room_m174_sewer2);
    __romPos = ALIGN(__romPos, 4);
    . = ALIGN(., 4);
    room_m174_sewer2_ROM_END = __romPos;
    room_m174_sewer2_VRAM_END = .;

    /DISCARD/ :
    {
        *(*);
    }
}
