SECTIONS
{
    HIDDEN(__romPos = 0);
    room_m146_hospital_ROM_START = __romPos;
    room_m146_hospital_VRAM = ADDR(.room_m146_hospital);
    .room_m146_hospital (OVERLAY_WINDOW_ROOM + 0x0) : AT(room_m146_hospital_ROM_START) SUBALIGN(4)
    {
        FILL(0x00000000);
        room_m146_hospital_RODATA_START = .;
        build/JP/overlays/room_m146_hospital/asm/JP/overlays/room_m146_hospital/data/room_m146_hospital.rodata.s.o(.rodata);
        build/JP/overlays/room_m146_hospital/src/jp/overlays/room_lib/ground_eruption.c.o(.rodata);
        build/JP/overlays/room_m146_hospital/src/jp/overlays/room_lib/falling_sprite_burst.c.o(.rodata);
        build/JP/overlays/room_m146_hospital/src/jp/overlays/room_lib/class_nop0.c.o(.rodata);
        build/JP/overlays/room_m146_hospital/src/jp/overlays/room_lib/class_plant_script.c.o(.rodata);
        build/JP/overlays/room_m146_hospital/src/jp/overlays/room_lib/class_spawn.c.o(.rodata);
        build/JP/overlays/room_m146_hospital/src/jp/overlays/room_lib/class_register_draw_list.c.o(.rodata);
        build/JP/overlays/room_m146_hospital/src/jp/overlays/room_lib/class_register_tables.c.o(.rodata);
        build/JP/overlays/room_m146_hospital/src/jp/overlays/room_lib/class_close_target.c.o(.rodata);
        build/JP/overlays/room_m146_hospital/src/jp/overlays/room_lib/class_nop6.c.o(.rodata);
        build/JP/overlays/room_m146_hospital/src/jp/overlays/room_lib/homing_projectile.c.o(.rodata);
        . = ALIGN(., 4);
        room_m146_hospital_RODATA_END = .;
        room_m146_hospital_RODATA_SIZE = ABSOLUTE(room_m146_hospital_RODATA_END - room_m146_hospital_RODATA_START);
        room_m146_hospital_TEXT_START = .;
        build/JP/overlays/room_m146_hospital/src/jp/overlays/room_lib/ground_eruption.c.o(.text);
        build/JP/overlays/room_m146_hospital/src/jp/overlays/room_lib/class_nop0.c.o(.text);
        build/JP/overlays/room_m146_hospital/src/jp/overlays/room_lib/class_plant_script.c.o(.text);
        build/JP/overlays/room_m146_hospital/src/jp/overlays/room_lib/class_spawn.c.o(.text);
        build/JP/overlays/room_m146_hospital/src/jp/overlays/room_lib/class_register_draw_list.c.o(.text);
        build/JP/overlays/room_m146_hospital/src/jp/overlays/room_lib/class_register_tables.c.o(.text);
        build/JP/overlays/room_m146_hospital/src/jp/overlays/room_lib/class_close_target.c.o(.text);
        build/JP/overlays/room_m146_hospital/src/jp/overlays/room_lib/class_nop6.c.o(.text);
        build/JP/overlays/room_m146_hospital/src/jp/overlays/room_lib/falling_sprite_burst.c.o(.text);
        build/JP/overlays/room_m146_hospital/src/jp/overlays/room_lib/homing_projectile.c.o(.text);
        . = ALIGN(., 4);
        room_m146_hospital_TEXT_END = .;
        room_m146_hospital_TEXT_SIZE = ABSOLUTE(room_m146_hospital_TEXT_END - room_m146_hospital_TEXT_START);
        room_m146_hospital_DATA_START = .;
        build/JP/overlays/room_m146_hospital/asm/JP/overlays/room_m146_hospital/data/room_m146_hospital.rodata.s.o(.data);
        build/JP/overlays/room_m146_hospital/src/jp/overlays/room_lib/ground_eruption.c.o(.data);
        build/JP/overlays/room_m146_hospital/src/jp/overlays/room_lib/falling_sprite_burst.c.o(.data);
        build/JP/overlays/room_m146_hospital/src/jp/overlays/room_lib/class_nop0.c.o(.data);
        build/JP/overlays/room_m146_hospital/src/jp/overlays/room_lib/class_plant_script.c.o(.data);
        build/JP/overlays/room_m146_hospital/src/jp/overlays/room_lib/class_spawn.c.o(.data);
        build/JP/overlays/room_m146_hospital/src/jp/overlays/room_lib/class_register_draw_list.c.o(.data);
        build/JP/overlays/room_m146_hospital/src/jp/overlays/room_lib/class_register_tables.c.o(.data);
        build/JP/overlays/room_m146_hospital/src/jp/overlays/room_lib/class_close_target.c.o(.data);
        build/JP/overlays/room_m146_hospital/src/jp/overlays/room_lib/class_nop6.c.o(.data);
        build/JP/overlays/room_m146_hospital/src/jp/overlays/room_lib/homing_projectile.c.o(.data);
        build/JP/overlays/room_m146_hospital/asm/JP/overlays/room_m146_hospital/data/D_80192448.data.s.o(.data);
        build/JP/overlays/room_m146_hospital/asm/JP/overlays/room_m146_hospital/data/RoomLib_TableC.data.s.o(.data);
        build/JP/overlays/room_m146_hospital/asm/JP/overlays/room_m146_hospital/data/D_80192480.data.s.o(.data);
        build/JP/overlays/room_m146_hospital/asm/JP/overlays/room_m146_hospital/data/D_8019249C.data.s.o(.data);
        build/JP/overlays/room_m146_hospital/asm/JP/overlays/room_m146_hospital/data/D_801924AC.data.s.o(.data);
        build/JP/overlays/room_m146_hospital/asm/JP/overlays/room_m146_hospital/data/RoomLib_TableB_8018F084.data.s.o(.data);
        build/JP/overlays/room_m146_hospital/asm/JP/overlays/room_m146_hospital/data/D_80192510.data.s.o(.data);
        build/JP/overlays/room_m146_hospital/asm/JP/overlays/room_m146_hospital/data/RoomLib_TableA_801905A0.data.s.o(.data);
        build/JP/overlays/room_m146_hospital/asm/JP/overlays/room_m146_hospital/data/D_80192540.data.s.o(.data);
        build/JP/overlays/room_m146_hospital/asm/JP/overlays/room_m146_hospital/data/D_80192558.data.s.o(.data);
        build/JP/overlays/room_m146_hospital/asm/JP/overlays/room_m146_hospital/data/D_80192564.data.s.o(.data);
        build/JP/overlays/room_m146_hospital/asm/JP/overlays/room_m146_hospital/data/RoomLib_TableB_80190548.data.s.o(.data);
        build/JP/overlays/room_m146_hospital/asm/JP/overlays/room_m146_hospital/data/D_801925CC.data.s.o(.data);
        build/JP/overlays/room_m146_hospital/src/jp/overlays/room_lib/homing_projectile_seeds.c.o(.data);
        build/JP/overlays/room_m146_hospital/asm/JP/overlays/room_m146_hospital/data/D_8019260C.data.s.o(.data);
        build/JP/overlays/room_m146_hospital/asm/JP/overlays/room_m146_hospital/data/g_RoomHomingLaunch.data.s.o(.data);
        build/JP/overlays/room_m146_hospital/asm/JP/overlays/room_m146_hospital/data/D_80192668.data.s.o(.data);
        build/JP/overlays/room_m146_hospital/asm/JP/overlays/room_m146_hospital/data/D_8019266C.data.s.o(.data);
        build/JP/overlays/room_m146_hospital/asm/JP/overlays/room_m146_hospital/data/D_80192670.data.s.o(.data);
        build/JP/overlays/room_m146_hospital/asm/JP/overlays/room_m146_hospital/data/D_80192678.data.s.o(.data);
        build/JP/overlays/room_m146_hospital/asm/JP/overlays/room_m146_hospital/data/D_8019267C.data.s.o(.data);
        build/JP/overlays/room_m146_hospital/asm/JP/overlays/room_m146_hospital/data/D_80192680.data.s.o(.data);
        build/JP/overlays/room_m146_hospital/asm/JP/overlays/room_m146_hospital/data/D_80192688.data.s.o(.data);
        build/JP/overlays/room_m146_hospital/asm/JP/overlays/room_m146_hospital/data/D_8019268C.data.s.o(.data);
        build/JP/overlays/room_m146_hospital/asm/JP/overlays/room_m146_hospital/data/D_80192690.data.s.o(.data);
        build/JP/overlays/room_m146_hospital/asm/JP/overlays/room_m146_hospital/data/D_80192698.data.s.o(.data);
        build/JP/overlays/room_m146_hospital/asm/JP/overlays/room_m146_hospital/data/D_8019269C.data.s.o(.data);
        build/JP/overlays/room_m146_hospital/asm/JP/overlays/room_m146_hospital/data/D_801926A0.data.s.o(.data);
        build/JP/overlays/room_m146_hospital/asm/JP/overlays/room_m146_hospital/data/D_801926A8.data.s.o(.data);
        build/JP/overlays/room_m146_hospital/asm/JP/overlays/room_m146_hospital/data/D_801926AC.data.s.o(.data);
        build/JP/overlays/room_m146_hospital/asm/JP/overlays/room_m146_hospital/data/D_801926B0.data.s.o(.data);
        build/JP/overlays/room_m146_hospital/asm/JP/overlays/room_m146_hospital/data/D_801926B8.data.s.o(.data);
        build/JP/overlays/room_m146_hospital/asm/JP/overlays/room_m146_hospital/data/D_801926BC.data.s.o(.data);
        build/JP/overlays/room_m146_hospital/asm/JP/overlays/room_m146_hospital/data/D_801926C0.data.s.o(.data);
        build/JP/overlays/room_m146_hospital/asm/JP/overlays/room_m146_hospital/data/D_801926C8.data.s.o(.data);
        build/JP/overlays/room_m146_hospital/asm/JP/overlays/room_m146_hospital/data/D_801926CC.data.s.o(.data);
        build/JP/overlays/room_m146_hospital/asm/JP/overlays/room_m146_hospital/data/D_801926D0.data.s.o(.data);
        build/JP/overlays/room_m146_hospital/asm/JP/overlays/room_m146_hospital/data/D_801926D8.data.s.o(.data);
        build/JP/overlays/room_m146_hospital/asm/JP/overlays/room_m146_hospital/data/D_801926DC.data.s.o(.data);
        build/JP/overlays/room_m146_hospital/asm/JP/overlays/room_m146_hospital/data/D_801926E0.data.s.o(.data);
        build/JP/overlays/room_m146_hospital/asm/JP/overlays/room_m146_hospital/data/D_801926E8.data.s.o(.data);
        build/JP/overlays/room_m146_hospital/asm/JP/overlays/room_m146_hospital/data/D_801926EC.data.s.o(.data);
        build/JP/overlays/room_m146_hospital/asm/JP/overlays/room_m146_hospital/data/D_801926F0.data.s.o(.data);
        build/JP/overlays/room_m146_hospital/asm/JP/overlays/room_m146_hospital/data/room_m146_hospital/D_801981F0.s.o(.data);
        build/JP/overlays/room_m146_hospital/asm/JP/overlays/room_m146_hospital/data/D_801DE3DC.data.s.o(.data);
        build/JP/overlays/room_m146_hospital/asm/JP/overlays/room_m146_hospital/data/room_m146_hospital/D_801DE400.s.o(.data);
        . = ALIGN(., 4);
        room_m146_hospital_DATA_END = .;
        room_m146_hospital_DATA_SIZE = ABSOLUTE(room_m146_hospital_DATA_END - room_m146_hospital_DATA_START);
        room_m146_hospital_BSS_START = .;
        build/JP/overlays/room_m146_hospital/asm/JP/overlays/room_m146_hospital/data/room_m146_hospital.rodata.s.o(.bss);
        build/JP/overlays/room_m146_hospital/src/jp/overlays/room_lib/ground_eruption.c.o(.bss);
        build/JP/overlays/room_m146_hospital/src/jp/overlays/room_lib/falling_sprite_burst.c.o(.bss);
        build/JP/overlays/room_m146_hospital/src/jp/overlays/room_lib/class_nop0.c.o(.bss);
        build/JP/overlays/room_m146_hospital/src/jp/overlays/room_lib/class_plant_script.c.o(.bss);
        build/JP/overlays/room_m146_hospital/src/jp/overlays/room_lib/class_spawn.c.o(.bss);
        build/JP/overlays/room_m146_hospital/src/jp/overlays/room_lib/class_register_draw_list.c.o(.bss);
        build/JP/overlays/room_m146_hospital/src/jp/overlays/room_lib/class_register_tables.c.o(.bss);
        build/JP/overlays/room_m146_hospital/src/jp/overlays/room_lib/class_close_target.c.o(.bss);
        build/JP/overlays/room_m146_hospital/src/jp/overlays/room_lib/class_nop6.c.o(.bss);
        build/JP/overlays/room_m146_hospital/src/jp/overlays/room_lib/homing_projectile.c.o(.bss);
        . = ALIGN(., 4);
        room_m146_hospital_BSS_END = .;
        room_m146_hospital_BSS_SIZE = ABSOLUTE(room_m146_hospital_BSS_END - room_m146_hospital_BSS_START);
    }
    __romPos += SIZEOF(.room_m146_hospital);
    __romPos = ALIGN(__romPos, 4);
    . = ALIGN(., 4);
    room_m146_hospital_ROM_END = __romPos;
    room_m146_hospital_VRAM_END = .;

    /DISCARD/ :
    {
        *(*);
    }
}
