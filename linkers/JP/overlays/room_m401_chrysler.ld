SECTIONS
{
    HIDDEN(__romPos = 0);
    room_m401_chrysler_ROM_START = __romPos;
    room_m401_chrysler_VRAM = ADDR(.room_m401_chrysler);
    .room_m401_chrysler (OVERLAY_WINDOW_ROOM + 0x0) : AT(room_m401_chrysler_ROM_START) SUBALIGN(4)
    {
        FILL(0x00000000);
        room_m401_chrysler_RODATA_START = .;
        build/JP/overlays/room_m401_chrysler/asm/JP/overlays/room_m401_chrysler/data/room_m401_chrysler.rodata.s.o(.rodata);
        build/JP/overlays/room_m401_chrysler/src-jp/overlays/room_lib/three_particles.c.o(.rodata);
        build/JP/overlays/room_m401_chrysler/src-jp/overlays/room_lib/falling_sprite_burst.c.o(.rodata);
        build/JP/overlays/room_m401_chrysler/src-jp/overlays/room_lib/actor_classes.c.o(.rodata);
        build/JP/overlays/room_m401_chrysler/src-jp/overlays/room_lib/timed_spawn.c.o(.rodata);
        build/JP/overlays/room_m401_chrysler/src-jp/overlays/room_lib/class_nop0.c.o(.rodata);
        build/JP/overlays/room_m401_chrysler/src-jp/overlays/room_lib/class_plant_script.c.o(.rodata);
        build/JP/overlays/room_m401_chrysler/src-jp/overlays/room_lib/class_spawn.c.o(.rodata);
        build/JP/overlays/room_m401_chrysler/src-jp/overlays/room_lib/class_register_draw_list.c.o(.rodata);
        build/JP/overlays/room_m401_chrysler/src-jp/overlays/room_lib/class_register_tables.c.o(.rodata);
        build/JP/overlays/room_m401_chrysler/src-jp/overlays/room_lib/class_close_target.c.o(.rodata);
        build/JP/overlays/room_m401_chrysler/src-jp/overlays/room_lib/class_nop6.c.o(.rodata);
        build/JP/overlays/room_m401_chrysler/src-jp/overlays/room_lib/floor_walker_class.c.o(.rodata);
        . = ALIGN(., 4);
        room_m401_chrysler_RODATA_END = .;
        room_m401_chrysler_RODATA_SIZE = ABSOLUTE(room_m401_chrysler_RODATA_END - room_m401_chrysler_RODATA_START);
        room_m401_chrysler_TEXT_START = .;
        build/JP/overlays/room_m401_chrysler/src-jp/overlays/room_lib/three_particles.c.o(.text);
        build/JP/overlays/room_m401_chrysler/src-jp/overlays/room_lib/class_nop0.c.o(.text);
        build/JP/overlays/room_m401_chrysler/src-jp/overlays/room_lib/class_plant_script.c.o(.text);
        build/JP/overlays/room_m401_chrysler/src-jp/overlays/room_lib/class_spawn.c.o(.text);
        build/JP/overlays/room_m401_chrysler/src-jp/overlays/room_lib/class_register_draw_list.c.o(.text);
        build/JP/overlays/room_m401_chrysler/src-jp/overlays/room_lib/class_register_tables.c.o(.text);
        build/JP/overlays/room_m401_chrysler/src-jp/overlays/room_lib/class_close_target.c.o(.text);
        build/JP/overlays/room_m401_chrysler/src-jp/overlays/room_lib/class_nop6.c.o(.text);
        build/JP/overlays/room_m401_chrysler/src-jp/overlays/room_lib/falling_sprite_burst.c.o(.text);
        build/JP/overlays/room_m401_chrysler/src-jp/overlays/room_lib/actor_classes.c.o(.text);
        build/JP/overlays/room_m401_chrysler/src-jp/overlays/room_lib/floor_walker_class.c.o(.text);
        build/JP/overlays/room_m401_chrysler/src-jp/overlays/room_lib/timed_spawn.c.o(.text);
        . = ALIGN(., 4);
        room_m401_chrysler_TEXT_END = .;
        room_m401_chrysler_TEXT_SIZE = ABSOLUTE(room_m401_chrysler_TEXT_END - room_m401_chrysler_TEXT_START);
        room_m401_chrysler_DATA_START = .;
        build/JP/overlays/room_m401_chrysler/asm/JP/overlays/room_m401_chrysler/data/room_m401_chrysler.rodata.s.o(.data);
        build/JP/overlays/room_m401_chrysler/src-jp/overlays/room_lib/three_particles.c.o(.data);
        build/JP/overlays/room_m401_chrysler/src-jp/overlays/room_lib/falling_sprite_burst.c.o(.data);
        build/JP/overlays/room_m401_chrysler/src-jp/overlays/room_lib/actor_classes.c.o(.data);
        build/JP/overlays/room_m401_chrysler/src-jp/overlays/room_lib/timed_spawn.c.o(.data);
        build/JP/overlays/room_m401_chrysler/src-jp/overlays/room_lib/class_nop0.c.o(.data);
        build/JP/overlays/room_m401_chrysler/src-jp/overlays/room_lib/class_plant_script.c.o(.data);
        build/JP/overlays/room_m401_chrysler/src-jp/overlays/room_lib/class_spawn.c.o(.data);
        build/JP/overlays/room_m401_chrysler/src-jp/overlays/room_lib/class_register_draw_list.c.o(.data);
        build/JP/overlays/room_m401_chrysler/src-jp/overlays/room_lib/class_register_tables.c.o(.data);
        build/JP/overlays/room_m401_chrysler/src-jp/overlays/room_lib/class_close_target.c.o(.data);
        build/JP/overlays/room_m401_chrysler/src-jp/overlays/room_lib/class_nop6.c.o(.data);
        build/JP/overlays/room_m401_chrysler/src-jp/overlays/room_lib/floor_walker_class.c.o(.data);
        build/JP/overlays/room_m401_chrysler/asm/JP/overlays/room_m401_chrysler/data/D_80195314.data.s.o(.data);
        build/JP/overlays/room_m401_chrysler/asm/JP/overlays/room_m401_chrysler/data/RoomLib_TableA_8018F26C.data.s.o(.data);
        build/JP/overlays/room_m401_chrysler/asm/JP/overlays/room_m401_chrysler/data/D_8019532C.data.s.o(.data);
        build/JP/overlays/room_m401_chrysler/asm/JP/overlays/room_m401_chrysler/data/D_80195338.data.s.o(.data);
        build/JP/overlays/room_m401_chrysler/asm/JP/overlays/room_m401_chrysler/data/D_80195340.data.s.o(.data);
        build/JP/overlays/room_m401_chrysler/asm/JP/overlays/room_m401_chrysler/data/D_8019535C.data.s.o(.data);
        build/JP/overlays/room_m401_chrysler/asm/JP/overlays/room_m401_chrysler/data/D_80195394.data.s.o(.data);
        build/JP/overlays/room_m401_chrysler/asm/JP/overlays/room_m401_chrysler/data/D_801953A4.data.s.o(.data);
        build/JP/overlays/room_m401_chrysler/asm/JP/overlays/room_m401_chrysler/data/RoomLib_TableA_80190270.data.s.o(.data);
        build/JP/overlays/room_m401_chrysler/asm/JP/overlays/room_m401_chrysler/data/D_801953D4.data.s.o(.data);
        build/JP/overlays/room_m401_chrysler/asm/JP/overlays/room_m401_chrysler/data/D_801953EC.data.s.o(.data);
        build/JP/overlays/room_m401_chrysler/asm/JP/overlays/room_m401_chrysler/data/D_801953F8.data.s.o(.data);
        build/JP/overlays/room_m401_chrysler/asm/JP/overlays/room_m401_chrysler/data/RoomLib_TableB_80190218.data.s.o(.data);
        build/JP/overlays/room_m401_chrysler/src-jp/overlays/room_lib/actor_class_table.c.o(.data);
        build/JP/overlays/room_m401_chrysler/asm/JP/overlays/room_m401_chrysler/data/D_80195508.data.s.o(.data);
        build/JP/overlays/room_m401_chrysler/asm/JP/overlays/room_m401_chrysler/data/D_80195524.data.s.o(.data);
        build/JP/overlays/room_m401_chrysler/asm/JP/overlays/room_m401_chrysler/data/D_80195544.data.s.o(.data);
        build/JP/overlays/room_m401_chrysler/asm/JP/overlays/room_m401_chrysler/data/D_80195564.data.s.o(.data);
        build/JP/overlays/room_m401_chrysler/asm/JP/overlays/room_m401_chrysler/data/D_801955A0.data.s.o(.data);
        build/JP/overlays/room_m401_chrysler/asm/JP/overlays/room_m401_chrysler/data/D_801955A4.data.s.o(.data);
        build/JP/overlays/room_m401_chrysler/asm/JP/overlays/room_m401_chrysler/data/D_801955A8.data.s.o(.data);
        build/JP/overlays/room_m401_chrysler/asm/JP/overlays/room_m401_chrysler/data/D_801955B0.data.s.o(.data);
        build/JP/overlays/room_m401_chrysler/asm/JP/overlays/room_m401_chrysler/data/D_801955B4.data.s.o(.data);
        build/JP/overlays/room_m401_chrysler/asm/JP/overlays/room_m401_chrysler/data/D_801955B8.data.s.o(.data);
        build/JP/overlays/room_m401_chrysler/asm/JP/overlays/room_m401_chrysler/data/D_801955C0.data.s.o(.data);
        build/JP/overlays/room_m401_chrysler/asm/JP/overlays/room_m401_chrysler/data/D_801955C4.data.s.o(.data);
        build/JP/overlays/room_m401_chrysler/asm/JP/overlays/room_m401_chrysler/data/D_801955C8.data.s.o(.data);
        build/JP/overlays/room_m401_chrysler/asm/JP/overlays/room_m401_chrysler/data/D_801955D0.data.s.o(.data);
        build/JP/overlays/room_m401_chrysler/asm/JP/overlays/room_m401_chrysler/data/D_801955D4.data.s.o(.data);
        build/JP/overlays/room_m401_chrysler/asm/JP/overlays/room_m401_chrysler/data/D_801955D8.data.s.o(.data);
        build/JP/overlays/room_m401_chrysler/asm/JP/overlays/room_m401_chrysler/data/D_801955E0.data.s.o(.data);
        build/JP/overlays/room_m401_chrysler/asm/JP/overlays/room_m401_chrysler/data/D_801955E4.data.s.o(.data);
        build/JP/overlays/room_m401_chrysler/asm/JP/overlays/room_m401_chrysler/data/D_801955E8.data.s.o(.data);
        build/JP/overlays/room_m401_chrysler/asm/JP/overlays/room_m401_chrysler/data/D_801955F0.data.s.o(.data);
        build/JP/overlays/room_m401_chrysler/asm/JP/overlays/room_m401_chrysler/data/D_801955F4.data.s.o(.data);
        build/JP/overlays/room_m401_chrysler/asm/JP/overlays/room_m401_chrysler/data/D_801955F8.data.s.o(.data);
        build/JP/overlays/room_m401_chrysler/asm/JP/overlays/room_m401_chrysler/data/D_80195600.data.s.o(.data);
        build/JP/overlays/room_m401_chrysler/asm/JP/overlays/room_m401_chrysler/data/D_80195604.data.s.o(.data);
        build/JP/overlays/room_m401_chrysler/asm/JP/overlays/room_m401_chrysler/data/room_m401_chrysler/D_80195608.s.o(.data);
        build/JP/overlays/room_m401_chrysler/asm/JP/overlays/room_m401_chrysler/data/room_m401_chrysler/D_801C01E4.s.o(.data);
        build/JP/overlays/room_m401_chrysler/asm/JP/overlays/room_m401_chrysler/data/D_801D4E0C.data.s.o(.data);
        build/JP/overlays/room_m401_chrysler/asm/JP/overlays/room_m401_chrysler/data/room_m401_chrysler/D_801D4E48.s.o(.data);
        . = ALIGN(., 4);
        room_m401_chrysler_DATA_END = .;
        room_m401_chrysler_DATA_SIZE = ABSOLUTE(room_m401_chrysler_DATA_END - room_m401_chrysler_DATA_START);
        room_m401_chrysler_BSS_START = .;
        build/JP/overlays/room_m401_chrysler/asm/JP/overlays/room_m401_chrysler/data/room_m401_chrysler.rodata.s.o(.bss);
        build/JP/overlays/room_m401_chrysler/src-jp/overlays/room_lib/three_particles.c.o(.bss);
        build/JP/overlays/room_m401_chrysler/src-jp/overlays/room_lib/falling_sprite_burst.c.o(.bss);
        build/JP/overlays/room_m401_chrysler/src-jp/overlays/room_lib/actor_classes.c.o(.bss);
        build/JP/overlays/room_m401_chrysler/src-jp/overlays/room_lib/timed_spawn.c.o(.bss);
        build/JP/overlays/room_m401_chrysler/src-jp/overlays/room_lib/class_nop0.c.o(.bss);
        build/JP/overlays/room_m401_chrysler/src-jp/overlays/room_lib/class_plant_script.c.o(.bss);
        build/JP/overlays/room_m401_chrysler/src-jp/overlays/room_lib/class_spawn.c.o(.bss);
        build/JP/overlays/room_m401_chrysler/src-jp/overlays/room_lib/class_register_draw_list.c.o(.bss);
        build/JP/overlays/room_m401_chrysler/src-jp/overlays/room_lib/class_register_tables.c.o(.bss);
        build/JP/overlays/room_m401_chrysler/src-jp/overlays/room_lib/class_close_target.c.o(.bss);
        build/JP/overlays/room_m401_chrysler/src-jp/overlays/room_lib/class_nop6.c.o(.bss);
        build/JP/overlays/room_m401_chrysler/src-jp/overlays/room_lib/floor_walker_class.c.o(.bss);
        . = ALIGN(., 4);
        room_m401_chrysler_BSS_END = .;
        room_m401_chrysler_BSS_SIZE = ABSOLUTE(room_m401_chrysler_BSS_END - room_m401_chrysler_BSS_START);
    }
    __romPos += SIZEOF(.room_m401_chrysler);
    __romPos = ALIGN(__romPos, 4);
    . = ALIGN(., 4);
    room_m401_chrysler_ROM_END = __romPos;
    room_m401_chrysler_VRAM_END = .;

    /DISCARD/ :
    {
        *(*);
    }
}
